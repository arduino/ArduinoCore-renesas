/*
  Software Secure Element Certificate

  This sketch uses the Software Secure Element to store device certificate and read it back.

  Circuit:
   - UNO R4 WiFi
*/

#include <SoftwareATSE.h>

const byte certificate[410] = {
  0x30 ,0x82 ,0x01 ,0x96 ,0x30 ,0x82 ,0x01 ,0x3D ,0xA0 ,0x03 ,0x02 ,0x01 ,0x02 ,0x02 ,0x10 ,0x37,
  0xFE ,0x48 ,0x92 ,0xE6 ,0xC0 ,0xA0 ,0x64 ,0x68 ,0x91 ,0x66 ,0x5F ,0x7D ,0xE3 ,0x02 ,0xDE ,0x30,
  0x0A ,0x06 ,0x08 ,0x2A ,0x86 ,0x48 ,0xCE ,0x3D ,0x04 ,0x03 ,0x02 ,0x30 ,0x45 ,0x31 ,0x0B ,0x30,
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  0x1A ,0xE2 ,0xEC ,0x64 ,0x19 ,0xB4 ,0x59 ,0xB8 ,0x09 ,0x78
};

void printBufferHex(const byte input[], size_t inputLength) {
    Serial.println(inputLength);
  for (size_t i = 0; i < inputLength; i++) {
    Serial.print(input[i] >> 4, HEX);
    Serial.print(input[i] & 0x0f, HEX);
  }
  Serial.println();
}

void setup() {
  Serial.begin(9600);
  while (!Serial);

  if (!SATSE.begin()) {
    Serial.println("Failed to communicate with Software Secure Element!");
    Serial.println("Make sure your WiFi firmware version is greater than 0.3.0");
    while (1);
  }

  const int certId = 799;

  if(SATSE.writeSlot(certId, certificate, sizeof(certificate))) {
    Serial.println("Data stored");
  } else {
    Serial.println("Failed to store data");
    return;
  }

  byte buf[512];
  int ret = 0;

  if((ret = SATSE.readSlot(certId, buf, sizeof(buf))) > 0) {
    Serial.print("Readback data is:                ");
    int len = (buf[2] << 8) + buf[3] + 4;
    printBufferHex(buf, len);
  } else {
    Serial.println("Failed to read data");
    return;
  }

}

void loop() {

}
