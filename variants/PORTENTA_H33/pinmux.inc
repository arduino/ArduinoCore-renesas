const uint16_t P109[] = {
PIN_CAN_TX|CHANNEL_1,
PIN_PWM|CHANNEL_1|PWM_CHANNEL_A|GPT_ODD_CFG,
SCI_CHANNEL|PIN_TX_MOSI_SDA|CHANNEL_9|SCI_ODD_CFG,
PIN_MOSI|CHANNEL_0|LAST_ITEM_GUARD
};

const uint16_t P900[] = {
SCI_CHANNEL|PIN_TX_MOSI_SDA|CHANNEL_4|SCI_EVEN_CFG|LAST_ITEM_GUARD
};

const uint16_t P204[] = {
PIN_PWM|CHANNEL_4|PWM_CHANNEL_B|GPT_ODD_CFG,
SCI_CHANNEL|PIN_SCK|CHANNEL_4|SCI_EVEN_CFG,
SCI_CHANNEL|PIN_SCK|CHANNEL_9|SCI_ODD_CFG,
PIN_SCK|CHANNEL_0|LAST_ITEM_GUARD
};

const uint16_t P407[] = {
PIN_PWM|CHANNEL_6|PWM_CHANNEL_A|GPT_ODD_CFG,
PIN_SDA|CHANNEL_0,
SCI_CHANNEL|PIN_CTSRTS|CHANNEL_4|SCI_EVEN_CFG|LAST_ITEM_GUARD
};

const uint16_t P301[] = {
PIN_PWM|CHANNEL_4|PWM_CHANNEL_B|GPT_ODD_CFG,
PIN_INTERRUPT|CHANNEL_6,
SCI_CHANNEL|PIN_RX_MISO_SCL|CHANNEL_2|SCI_EVEN_CFG,
SCI_CHANNEL|PIN_CTSRTS|CHANNEL_9|SCI_ODD_CFG|LAST_ITEM_GUARD
};

const uint16_t P303[] = {
PIN_PWM|CHANNEL_7|PWM_CHANNEL_B|GPT_ODD_CFG,
SCI_CHANNEL|PIN_CTS_RTS_SS|CHANNEL_9|SCI_ODD_CFG|LAST_ITEM_GUARD
};

const uint16_t P306[] = {
SCI_CHANNEL|PIN_SCK|CHANNEL_6|SCI_EVEN_CFG|LAST_ITEM_GUARD
};

const uint16_t P308[] = {
SCI_CHANNEL|PIN_CTS_RTS_SS|CHANNEL_3|SCI_ODD_CFG,
SCI_CHANNEL|PIN_CTS_RTS_SS|CHANNEL_6|SCI_EVEN_CFG|LAST_ITEM_GUARD
};

const uint16_t P310[] = {
SCI_CHANNEL|PIN_TX_MOSI_SDA|CHANNEL_3|SCI_ODD_CFG|LAST_ITEM_GUARD
};

const uint16_t P906[] = {
PIN_INTERRUPT|CHANNEL_9|LAST_ITEM_GUARD
};

const uint16_t P113[] = {
PIN_PWM|CHANNEL_2|PWM_CHANNEL_A|GPT_ODD_CFG,
SCI_CHANNEL|PIN_RX_MISO_SCL|CHANNEL_2|SCI_EVEN_CFG|LAST_ITEM_GUARD
};

const uint16_t P315[] = {
SCI_CHANNEL|PIN_RX_MISO_SCL|CHANNEL_4|SCI_EVEN_CFG|LAST_ITEM_GUARD
};

const uint16_t P202[] = {
PIN_CAN_RX|CHANNEL_0,
PIN_PWM|CHANNEL_5|PWM_CHANNEL_B|GPT_ODD_CFG,
PIN_INTERRUPT|CHANNEL_3,
SCI_CHANNEL|PIN_SCK|CHANNEL_2|SCI_EVEN_CFG,
SCI_CHANNEL|PIN_RX_MISO_SCL|CHANNEL_9|SCI_ODD_CFG,
PIN_MISO|CHANNEL_0|LAST_ITEM_GUARD
};

const uint16_t P409[] = {
PIN_INTERRUPT|CHANNEL_6,
PIN_SDA|CHANNEL_2,
SCI_CHANNEL|PIN_TX_MOSI_SDA|CHANNEL_3|SCI_ODD_CFG|LAST_ITEM_GUARD
};

const uint16_t P112[] = {
PIN_PWM|CHANNEL_3|PWM_CHANNEL_B|GPT_ODD_CFG,
SCI_CHANNEL|PIN_SCK|CHANNEL_1|SCI_ODD_CFG,
SCI_CHANNEL|PIN_TX_MOSI_SDA|CHANNEL_2|SCI_EVEN_CFG|LAST_ITEM_GUARD
};

const uint16_t P302[] = {
PIN_PWM|CHANNEL_4|PWM_CHANNEL_A|GPT_ODD_CFG,
PIN_INTERRUPT|CHANNEL_5,
SCI_CHANNEL|PIN_TX_MOSI_SDA|CHANNEL_2|SCI_EVEN_CFG|LAST_ITEM_GUARD
};

const uint16_t P304[] = {
PIN_PWM|CHANNEL_7|PWM_CHANNEL_A|GPT_ODD_CFG,
PIN_INTERRUPT|CHANNEL_9,
SCI_CHANNEL|PIN_RX_MISO_SCL|CHANNEL_6|SCI_EVEN_CFG|LAST_ITEM_GUARD
};

const uint16_t P305[] = {
PIN_INTERRUPT|CHANNEL_8,
SCI_CHANNEL|PIN_TX_MOSI_SDA|CHANNEL_6|SCI_EVEN_CFG|LAST_ITEM_GUARD
};

const uint16_t P309[] = {
SCI_CHANNEL|PIN_RX_MISO_SCL|CHANNEL_3|SCI_ODD_CFG|LAST_ITEM_GUARD
};

const uint16_t P905[] = {
PIN_INTERRUPT|CHANNEL_8|LAST_ITEM_GUARD
};

const uint16_t P115[] = {
PIN_PWM|CHANNEL_4|PWM_CHANNEL_A|GPT_ODD_CFG|LAST_ITEM_GUARD
};

const uint16_t P901[] = {
SCI_CHANNEL|PIN_SCK|CHANNEL_4|SCI_EVEN_CFG|LAST_ITEM_GUARD
};

const uint16_t P207[] = {
SCI_CHANNEL|PIN_TX_MOSI_SDA|CHANNEL_4|SCI_EVEN_CFG|LAST_ITEM_GUARD
};

const uint16_t P410[] = {
PIN_PWM|CHANNEL_9|PWM_CHANNEL_B|GPT_ODD_CFG,
PIN_INTERRUPT|CHANNEL_5,
PIN_SCL|CHANNEL_2,
SCI_CHANNEL|PIN_RX_MISO_SCL|CHANNEL_0|SCI_EVEN_CFG,
SCI_CHANNEL|PIN_SCK|CHANNEL_3|SCI_ODD_CFG,
PIN_MISO|CHANNEL_1|LAST_ITEM_GUARD
};

const uint16_t P411[] = {
PIN_PWM|CHANNEL_9|PWM_CHANNEL_A|GPT_ODD_CFG,
PIN_INTERRUPT|CHANNEL_4,
SCI_CHANNEL|PIN_TX_MOSI_SDA|CHANNEL_0|SCI_EVEN_CFG,
SCI_CHANNEL|PIN_CTSRTS|CHANNEL_3|SCI_ODD_CFG,
PIN_MOSI|CHANNEL_1|LAST_ITEM_GUARD
};

const uint16_t P114[] = {
PIN_PWM|CHANNEL_2|PWM_CHANNEL_B|GPT_ODD_CFG,
SCI_CHANNEL|PIN_CTS_RTS_SS|CHANNEL_9|SCI_ODD_CFG|LAST_ITEM_GUARD
};

const uint16_t P108[] = {
PIN_PWM|CHANNEL_0|PWM_CHANNEL_B|GPT_ODD_CFG,
SCI_CHANNEL|PIN_CTSRTS|CHANNEL_9|SCI_ODD_CFG|LAST_ITEM_GUARD
};

const uint16_t P300[] = {
PIN_PWM|CHANNEL_0|PWM_CHANNEL_A|GPT_ODD_CFG|LAST_ITEM_GUARD
};

const uint16_t P307[] = {
SCI_CHANNEL|PIN_CTSRTS|CHANNEL_6|SCI_EVEN_CFG|LAST_ITEM_GUARD
};

const uint16_t P312[] = {
SCI_CHANNEL|PIN_CTSRTS|CHANNEL_3|SCI_ODD_CFG|LAST_ITEM_GUARD
};

const uint16_t P200[] = {
PIN_INTERRUPT|CHANNEL_0|LAST_ITEM_GUARD
};

const uint16_t P609[] = {
PIN_CAN_TX|CHANNEL_1,
PIN_PWM|CHANNEL_5|PWM_CHANNEL_A|GPT_ODD_CFG|LAST_ITEM_GUARD
};

const uint16_t P203[] = {
PIN_CAN_TX|CHANNEL_0,
PIN_PWM|CHANNEL_5|PWM_CHANNEL_A|GPT_ODD_CFG,
PIN_INTERRUPT|CHANNEL_2,
SCI_CHANNEL|PIN_CTSRTS|CHANNEL_2|SCI_EVEN_CFG,
SCI_CHANNEL|PIN_TX_MOSI_SDA|CHANNEL_9|SCI_ODD_CFG,
PIN_MOSI|CHANNEL_0|LAST_ITEM_GUARD
};

const uint16_t P206[] = {
PIN_INTERRUPT|CHANNEL_0,
PIN_SDA|CHANNEL_1,
SCI_CHANNEL|PIN_RX_MISO_SCL|CHANNEL_4|SCI_EVEN_CFG,
SCI_CHANNEL|PIN_CTS_RTS_SS|CHANNEL_9|SCI_ODD_CFG|LAST_ITEM_GUARD
};

const uint16_t P408[] = {
PIN_PWM|CHANNEL_6|PWM_CHANNEL_B|GPT_ODD_CFG,
PIN_INTERRUPT|CHANNEL_7,
PIN_SCL|CHANNEL_0,
SCI_CHANNEL|PIN_RX_MISO_SCL|CHANNEL_3|SCI_ODD_CFG,
SCI_CHANNEL|PIN_CTS_RTS_SS|CHANNEL_4|SCI_EVEN_CFG|LAST_ITEM_GUARD
};

const uint16_t P412[] = {
SCI_CHANNEL|PIN_SCK|CHANNEL_0|SCI_EVEN_CFG,
SCI_CHANNEL|PIN_CTS_RTS_SS|CHANNEL_3|SCI_ODD_CFG,
PIN_SCK|CHANNEL_1|LAST_ITEM_GUARD
};

const uint16_t P414[] = {
PIN_PWM|CHANNEL_0|PWM_CHANNEL_B|GPT_ODD_CFG,
PIN_INTERRUPT|CHANNEL_9,
PIN_SDA|CHANNEL_2,
SCI_CHANNEL|PIN_CTS_RTS_SS|CHANNEL_0|SCI_EVEN_CFG|LAST_ITEM_GUARD
};

const uint16_t P608[] = {
PIN_PWM|CHANNEL_4|PWM_CHANNEL_B|GPT_ODD_CFG|LAST_ITEM_GUARD
};

const uint16_t P110[] = {
PIN_CAN_RX|CHANNEL_1,
PIN_PWM|CHANNEL_1|PWM_CHANNEL_B|GPT_ODD_CFG,
PIN_INTERRUPT|CHANNEL_3,
SCI_CHANNEL|PIN_CTSRTS|CHANNEL_2|SCI_EVEN_CFG,
SCI_CHANNEL|PIN_RX_MISO_SCL|CHANNEL_9|SCI_ODD_CFG,
PIN_MISO|CHANNEL_0|LAST_ITEM_GUARD
};

const uint16_t P111[] = {
PIN_PWM|CHANNEL_3|PWM_CHANNEL_A|GPT_ODD_CFG,
PIN_INTERRUPT|CHANNEL_4,
SCI_CHANNEL|PIN_SCK|CHANNEL_2|SCI_EVEN_CFG,
SCI_CHANNEL|PIN_SCK|CHANNEL_9|SCI_ODD_CFG,
PIN_SCK|CHANNEL_0|LAST_ITEM_GUARD
};

const uint16_t P311[] = {
SCI_CHANNEL|PIN_SCK|CHANNEL_3|SCI_ODD_CFG|LAST_ITEM_GUARD
};

const uint16_t P907[] = {
PIN_INTERRUPT|CHANNEL_10|LAST_ITEM_GUARD
};

const uint16_t P908[] = {
PIN_INTERRUPT|CHANNEL_11|LAST_ITEM_GUARD
};

const uint16_t P612[] = {
SCI_CHANNEL|PIN_SCK|CHANNEL_7|SCI_ODD_CFG|LAST_ITEM_GUARD
};

const uint16_t P205[] = {
PIN_PWM|CHANNEL_4|PWM_CHANNEL_A|GPT_ODD_CFG,
PIN_INTERRUPT|CHANNEL_1,
PIN_SCL|CHANNEL_1,
SCI_CHANNEL|PIN_TX_MOSI_SDA|CHANNEL_4|SCI_EVEN_CFG,
SCI_CHANNEL|PIN_CTSRTS|CHANNEL_9|SCI_ODD_CFG|LAST_ITEM_GUARD
};

const uint16_t P413[] = {
SCI_CHANNEL|PIN_CTSRTS|CHANNEL_0|SCI_EVEN_CFG|LAST_ITEM_GUARD
};

const uint16_t P415[] = {
PIN_PWM|CHANNEL_0|PWM_CHANNEL_A|GPT_ODD_CFG,
PIN_INTERRUPT|CHANNEL_8,
PIN_SCL|CHANNEL_2|LAST_ITEM_GUARD
};

const uint16_t P708[] = {
PIN_INTERRUPT|CHANNEL_11,
SCI_CHANNEL|PIN_RX_MISO_SCL|CHANNEL_1|SCI_ODD_CFG|LAST_ITEM_GUARD
};

const uint16_t P611[] = {
SCI_CHANNEL|PIN_CTSRTS|CHANNEL_7|SCI_ODD_CFG|LAST_ITEM_GUARD
};

const uint16_t P615[] = {
PIN_INTERRUPT|CHANNEL_7|LAST_ITEM_GUARD
};

const uint16_t P614[] = {
SCI_CHANNEL|PIN_RX_MISO_SCL|CHANNEL_7|SCI_ODD_CFG|LAST_ITEM_GUARD
};

const uint16_t P610[] = {
PIN_CAN_RX|CHANNEL_1,
PIN_PWM|CHANNEL_5|PWM_CHANNEL_B|GPT_ODD_CFG,
SCI_CHANNEL|PIN_CTS_RTS_SS|CHANNEL_7|SCI_ODD_CFG|LAST_ITEM_GUARD
};

const uint16_t P613[] = {
SCI_CHANNEL|PIN_TX_MOSI_SDA|CHANNEL_7|SCI_ODD_CFG|LAST_ITEM_GUARD
};

const uint16_t PA08[] = {
PIN_INTERRUPT|CHANNEL_6|LAST_ITEM_GUARD
};

const uint16_t PA10[] = {
PIN_INTERRUPT|CHANNEL_4|LAST_ITEM_GUARD
};

const uint16_t PA09[] = {
PIN_INTERRUPT|CHANNEL_5|LAST_ITEM_GUARD
};

const uint16_t P213[] = {
PIN_PWM|CHANNEL_0|PWM_CHANNEL_A|GPT_ODD_CFG,
PIN_INTERRUPT|CHANNEL_2,
SCI_CHANNEL|PIN_TX_MOSI_SDA|CHANNEL_1|SCI_ODD_CFG|LAST_ITEM_GUARD
};

const uint16_t P212[] = {
PIN_PWM|CHANNEL_0|PWM_CHANNEL_B|GPT_ODD_CFG,
PIN_INTERRUPT|CHANNEL_3,
SCI_CHANNEL|PIN_RX_MISO_SCL|CHANNEL_1|SCI_ODD_CFG|LAST_ITEM_GUARD
};

const uint16_t PA01[] = {
SCI_CHANNEL|PIN_SCK|CHANNEL_8|SCI_EVEN_CFG|LAST_ITEM_GUARD
};

const uint16_t PA00[] = {
SCI_CHANNEL|PIN_TX_MOSI_SDA|CHANNEL_8|SCI_EVEN_CFG|LAST_ITEM_GUARD
};

const uint16_t P606[] = {
SCI_CHANNEL|PIN_CTSRTS|CHANNEL_8|SCI_EVEN_CFG|LAST_ITEM_GUARD
};

const uint16_t PB00[] = {
SCI_CHANNEL|PIN_SCK|CHANNEL_3|SCI_ODD_CFG|LAST_ITEM_GUARD
};

const uint16_t P605[] = {
PIN_PWM|CHANNEL_8|PWM_CHANNEL_A|GPT_ODD_CFG,
SCI_CHANNEL|PIN_CTS_RTS_SS|CHANNEL_8|SCI_EVEN_CFG|LAST_ITEM_GUARD
};

const uint16_t P604[] = {
PIN_PWM|CHANNEL_8|PWM_CHANNEL_B|GPT_ODD_CFG,
SCI_CHANNEL|PIN_CTS_RTS_SS|CHANNEL_9|SCI_ODD_CFG|LAST_ITEM_GUARD
};

const uint16_t P607[] = {
SCI_CHANNEL|PIN_RX_MISO_SCL|CHANNEL_8|SCI_EVEN_CFG|LAST_ITEM_GUARD
};

const uint16_t P602[] = {
PIN_PWM|CHANNEL_7|PWM_CHANNEL_B|GPT_ODD_CFG,
SCI_CHANNEL|PIN_TX_MOSI_SDA|CHANNEL_9|SCI_ODD_CFG|LAST_ITEM_GUARD
};

const uint16_t P705[] = {
PIN_CAN_RX|CHANNEL_0,
SCI_CHANNEL|PIN_CTS_RTS_SS|CHANNEL_3|SCI_ODD_CFG|LAST_ITEM_GUARD
};

const uint16_t PB01[] = {
SCI_CHANNEL|PIN_CTSRTS|CHANNEL_3|SCI_ODD_CFG|LAST_ITEM_GUARD
};

const uint16_t P601[] = {
PIN_PWM|CHANNEL_6|PWM_CHANNEL_A|GPT_ODD_CFG,
SCI_CHANNEL|PIN_RX_MISO_SCL|CHANNEL_9|SCI_ODD_CFG|LAST_ITEM_GUARD
};

const uint16_t P603[] = {
PIN_PWM|CHANNEL_7|PWM_CHANNEL_A|GPT_ODD_CFG,
SCI_CHANNEL|PIN_CTSRTS|CHANNEL_9|SCI_ODD_CFG|LAST_ITEM_GUARD
};

const uint16_t P600[] = {
PIN_PWM|CHANNEL_6|PWM_CHANNEL_B|GPT_ODD_CFG,
SCI_CHANNEL|PIN_SCK|CHANNEL_9|SCI_ODD_CFG|LAST_ITEM_GUARD
};

const uint16_t P702[] = {
PIN_PWM|CHANNEL_6|PWM_CHANNEL_A|GPT_ODD_CFG,
PIN_SCK|CHANNEL_0|LAST_ITEM_GUARD
};

const uint16_t P704[] = {
PIN_CAN_TX|CHANNEL_0|LAST_ITEM_GUARD
};

const uint16_t P706[] = {
PIN_INTERRUPT|CHANNEL_7,
SCI_CHANNEL|PIN_RX_MISO_SCL|CHANNEL_3|SCI_ODD_CFG|LAST_ITEM_GUARD
};

const uint16_t P707[] = {
PIN_INTERRUPT|CHANNEL_8,
SCI_CHANNEL|PIN_TX_MOSI_SDA|CHANNEL_3|SCI_ODD_CFG|LAST_ITEM_GUARD
};

const uint16_t P107[] = {
PIN_PWM|CHANNEL_8|PWM_CHANNEL_A|GPT_ODD_CFG,
SCI_CHANNEL|PIN_CTSRTS|CHANNEL_8|SCI_EVEN_CFG|LAST_ITEM_GUARD
};

const uint16_t P105[] = {
PIN_PWM|CHANNEL_1|PWM_CHANNEL_A|GPT_ODD_CFG,
PIN_INTERRUPT|CHANNEL_0,
SCI_CHANNEL|PIN_TX_MOSI_SDA|CHANNEL_8|SCI_EVEN_CFG|LAST_ITEM_GUARD
};

const uint16_t P106[] = {
PIN_PWM|CHANNEL_8|PWM_CHANNEL_B|GPT_ODD_CFG,
SCI_CHANNEL|PIN_SCK|CHANNEL_8|SCI_EVEN_CFG|LAST_ITEM_GUARD
};

const uint16_t P403[] = {
PIN_PWM|CHANNEL_3|PWM_CHANNEL_A|GPT_ODD_CFG,
PIN_INTERRUPT|CHANNEL_14,
SCI_CHANNEL|PIN_CTSRTS|CHANNEL_7|SCI_ODD_CFG|LAST_ITEM_GUARD
};

const uint16_t P404[] = {
PIN_PWM|CHANNEL_3|PWM_CHANNEL_B|GPT_ODD_CFG,
PIN_INTERRUPT|CHANNEL_15,
SCI_CHANNEL|PIN_CTS_RTS_SS|CHANNEL_7|SCI_ODD_CFG|LAST_ITEM_GUARD
};

const uint16_t P701[] = {
PIN_PWM|CHANNEL_5|PWM_CHANNEL_B|GPT_ODD_CFG,
PIN_MOSI|CHANNEL_0|LAST_ITEM_GUARD
};

const uint16_t P703[] = {
PIN_PWM|CHANNEL_6|PWM_CHANNEL_B|GPT_ODD_CFG|LAST_ITEM_GUARD
};

const uint16_t P104[] = {
PIN_PWM|CHANNEL_1|PWM_CHANNEL_B|GPT_ODD_CFG,
PIN_INTERRUPT|CHANNEL_1,
SCI_CHANNEL|PIN_RX_MISO_SCL|CHANNEL_8|SCI_EVEN_CFG|LAST_ITEM_GUARD
};

const uint16_t P102[] = {
PIN_CAN_RX|CHANNEL_0,
PIN_PWM|CHANNEL_2|PWM_CHANNEL_B|GPT_ODD_CFG,
SCI_CHANNEL|PIN_SCK|CHANNEL_0|SCI_EVEN_CFG,
PIN_SCK|CHANNEL_1|LAST_ITEM_GUARD
};

const uint16_t P003[] = {
PIN_ANALOG|CHANNEL_3|ADC_0|LAST_ITEM_GUARD
};

const uint16_t P007[] = {
PIN_ANALOG|CHANNEL_7|ADC_0|LAST_ITEM_GUARD
};

const uint16_t P010[] = {
PIN_ANALOG|CHANNEL_10|ADC_0,
PIN_INTERRUPT|CHANNEL_14|LAST_ITEM_GUARD
};

const uint16_t P009[] = {
PIN_ANALOG|CHANNEL_9|ADC_0,
PIN_INTERRUPT|CHANNEL_13|LAST_ITEM_GUARD
};

const uint16_t P103[] = {
PIN_CAN_TX|CHANNEL_0,
PIN_PWM|CHANNEL_2|PWM_CHANNEL_A|GPT_ODD_CFG,
SCI_CHANNEL|PIN_CTSRTS|CHANNEL_0|SCI_EVEN_CFG|LAST_ITEM_GUARD
};

const uint16_t P006[] = {
PIN_ANALOG|CHANNEL_6|ADC_0,
PIN_INTERRUPT|CHANNEL_11|LAST_ITEM_GUARD
};

const uint16_t P001[] = {
PIN_ANALOG|CHANNEL_1|ADC_0,
PIN_ANALOG|CHANNEL_1|ADC_1,
PIN_INTERRUPT|CHANNEL_7|LAST_ITEM_GUARD
};

const uint16_t P513[] = {
SCI_CHANNEL|PIN_RX_MISO_SCL|CHANNEL_5|SCI_ODD_CFG|LAST_ITEM_GUARD
};

const uint16_t P400[] = {
PIN_PWM|CHANNEL_6|PWM_CHANNEL_A|GPT_ODD_CFG,
PIN_INTERRUPT|CHANNEL_0,
PIN_SCL|CHANNEL_0,
SCI_CHANNEL|PIN_SCK|CHANNEL_4|SCI_EVEN_CFG,
SCI_CHANNEL|PIN_SCK|CHANNEL_7|SCI_ODD_CFG|LAST_ITEM_GUARD
};

const uint16_t P406[] = {
PIN_PWM|CHANNEL_1|PWM_CHANNEL_B|GPT_ODD_CFG|LAST_ITEM_GUARD
};

const uint16_t P700[] = {
PIN_PWM|CHANNEL_5|PWM_CHANNEL_A|GPT_ODD_CFG,
PIN_MISO|CHANNEL_0|LAST_ITEM_GUARD
};

const uint16_t P101[] = {
PIN_PWM|CHANNEL_5|PWM_CHANNEL_A|GPT_ODD_CFG,
PIN_INTERRUPT|CHANNEL_1,
SCI_CHANNEL|PIN_TX_MOSI_SDA|CHANNEL_0|SCI_EVEN_CFG,
SCI_CHANNEL|PIN_CTSRTS|CHANNEL_1|SCI_ODD_CFG,
PIN_MOSI|CHANNEL_1|LAST_ITEM_GUARD
};

const uint16_t P800[] = {
PIN_ANALOG|CHANNEL_25|ADC_1,
SCI_CHANNEL|PIN_CTS_RTS_SS|CHANNEL_0|SCI_EVEN_CFG|LAST_ITEM_GUARD
};

const uint16_t P503[] = {
PIN_ANALOG|CHANNEL_19|ADC_1,
SCI_CHANNEL|PIN_SCK|CHANNEL_5|SCI_ODD_CFG,
SCI_CHANNEL|PIN_CTSRTS|CHANNEL_6|SCI_EVEN_CFG|LAST_ITEM_GUARD
};

const uint16_t P507[] = {
PIN_ANALOG|CHANNEL_23|ADC_1,
SCI_CHANNEL|PIN_SCK|CHANNEL_5|SCI_ODD_CFG,
SCI_CHANNEL|PIN_SCK|CHANNEL_6|SCI_EVEN_CFG|LAST_ITEM_GUARD
};

const uint16_t P100[] = {
PIN_PWM|CHANNEL_5|PWM_CHANNEL_B|GPT_ODD_CFG,
PIN_INTERRUPT|CHANNEL_2,
SCI_CHANNEL|PIN_RX_MISO_SCL|CHANNEL_0|SCI_EVEN_CFG,
SCI_CHANNEL|PIN_SCK|CHANNEL_1|SCI_ODD_CFG,
PIN_MISO|CHANNEL_1|LAST_ITEM_GUARD
};

const uint16_t P008[] = {
PIN_ANALOG|CHANNEL_8|ADC_0,
PIN_INTERRUPT|CHANNEL_12|LAST_ITEM_GUARD
};

const uint16_t P004[] = {
PIN_ANALOG|CHANNEL_4|ADC_0,
PIN_INTERRUPT|CHANNEL_9|LAST_ITEM_GUARD
};

const uint16_t P806[] = {
PIN_INTERRUPT|CHANNEL_0|LAST_ITEM_GUARD
};

const uint16_t P511[] = {
PIN_CAN_RX|CHANNEL_1,
PIN_PWM|CHANNEL_0|PWM_CHANNEL_B|GPT_ODD_CFG,
PIN_INTERRUPT|CHANNEL_15,
PIN_SDA|CHANNEL_1,
SCI_CHANNEL|PIN_RX_MISO_SCL|CHANNEL_4|SCI_EVEN_CFG|LAST_ITEM_GUARD
};

const uint16_t P402[] = {
PIN_CAN_RX|CHANNEL_0,
PIN_INTERRUPT|CHANNEL_4,
SCI_CHANNEL|PIN_CTS_RTS_SS|CHANNEL_4|SCI_EVEN_CFG,
SCI_CHANNEL|PIN_RX_MISO_SCL|CHANNEL_7|SCI_ODD_CFG|LAST_ITEM_GUARD
};

const uint16_t P405[] = {
PIN_PWM|CHANNEL_1|PWM_CHANNEL_A|GPT_ODD_CFG|LAST_ITEM_GUARD
};

const uint16_t P802[] = {
PIN_ANALOG|CHANNEL_27|ADC_1,
PIN_INTERRUPT|CHANNEL_3|LAST_ITEM_GUARD
};

const uint16_t P804[] = {
PIN_INTERRUPT|CHANNEL_1|LAST_ITEM_GUARD
};

const uint16_t P501[] = {
PIN_ANALOG|CHANNEL_17|ADC_1,
PIN_INTERRUPT|CHANNEL_11,
SCI_CHANNEL|PIN_TX_MOSI_SDA|CHANNEL_5|SCI_ODD_CFG|LAST_ITEM_GUARD
};

const uint16_t P504[] = {
PIN_ANALOG|CHANNEL_20|ADC_1,
SCI_CHANNEL|PIN_CTSRTS|CHANNEL_5|SCI_ODD_CFG,
SCI_CHANNEL|PIN_SCK|CHANNEL_6|SCI_EVEN_CFG|LAST_ITEM_GUARD
};

const uint16_t P505[] = {
PIN_ANALOG|CHANNEL_21|ADC_1,
PIN_INTERRUPT|CHANNEL_14,
SCI_CHANNEL|PIN_RX_MISO_SCL|CHANNEL_6|SCI_EVEN_CFG|LAST_ITEM_GUARD
};

const uint16_t P015[] = {
PIN_ANALOG|CHANNEL_13|ADC_0,
PIN_INTERRUPT|CHANNEL_13|LAST_ITEM_GUARD
};

const uint16_t P801[] = {
PIN_ANALOG|CHANNEL_26|ADC_1,
SCI_CHANNEL|PIN_CTS_RTS_SS|CHANNEL_8|SCI_EVEN_CFG|LAST_ITEM_GUARD
};

const uint16_t P005[] = {
PIN_ANALOG|CHANNEL_5|ADC_0,
PIN_INTERRUPT|CHANNEL_10|LAST_ITEM_GUARD
};

const uint16_t P002[] = {
PIN_ANALOG|CHANNEL_2|ADC_0,
PIN_ANALOG|CHANNEL_2|ADC_1,
PIN_INTERRUPT|CHANNEL_8|LAST_ITEM_GUARD
};

const uint16_t P000[] = {
PIN_ANALOG|CHANNEL_0|ADC_0,
PIN_ANALOG|CHANNEL_0|ADC_1,
PIN_INTERRUPT|CHANNEL_6|LAST_ITEM_GUARD
};

const uint16_t P805[] = {
SCI_CHANNEL|PIN_TX_MOSI_SDA|CHANNEL_5|SCI_ODD_CFG|LAST_ITEM_GUARD
};

const uint16_t P512[] = {
PIN_CAN_TX|CHANNEL_1,
PIN_PWM|CHANNEL_0|PWM_CHANNEL_A|GPT_ODD_CFG,
PIN_INTERRUPT|CHANNEL_14,
PIN_SCL|CHANNEL_1,
SCI_CHANNEL|PIN_TX_MOSI_SDA|CHANNEL_4|SCI_EVEN_CFG|LAST_ITEM_GUARD
};

const uint16_t P401[] = {
PIN_CAN_TX|CHANNEL_0,
PIN_PWM|CHANNEL_6|PWM_CHANNEL_B|GPT_ODD_CFG,
PIN_INTERRUPT|CHANNEL_5,
PIN_SDA|CHANNEL_0,
SCI_CHANNEL|PIN_CTSRTS|CHANNEL_4|SCI_EVEN_CFG,
SCI_CHANNEL|PIN_TX_MOSI_SDA|CHANNEL_7|SCI_ODD_CFG|LAST_ITEM_GUARD
};

const uint16_t P803[] = {
PIN_ANALOG|CHANNEL_28|ADC_1,
PIN_INTERRUPT|CHANNEL_2|LAST_ITEM_GUARD
};

const uint16_t P500[] = {
PIN_ANALOG|CHANNEL_16|ADC_1,
SCI_CHANNEL|PIN_CTS_RTS_SS|CHANNEL_5|SCI_ODD_CFG|LAST_ITEM_GUARD
};

const uint16_t P502[] = {
PIN_ANALOG|CHANNEL_18|ADC_1,
PIN_INTERRUPT|CHANNEL_12,
SCI_CHANNEL|PIN_RX_MISO_SCL|CHANNEL_5|SCI_ODD_CFG,
SCI_CHANNEL|PIN_CTS_RTS_SS|CHANNEL_6|SCI_EVEN_CFG|LAST_ITEM_GUARD
};

const uint16_t P506[] = {
PIN_ANALOG|CHANNEL_22|ADC_1,
PIN_INTERRUPT|CHANNEL_15,
SCI_CHANNEL|PIN_TX_MOSI_SDA|CHANNEL_6|SCI_EVEN_CFG|LAST_ITEM_GUARD
};

const uint16_t P508[] = {
PIN_ANALOG|CHANNEL_24|ADC_1,
SCI_CHANNEL|PIN_CTSRTS|CHANNEL_5|SCI_ODD_CFG|LAST_ITEM_GUARD
};

const uint16_t P014[] = {
PIN_ANALOG|CHANNEL_12|ADC_0|LAST_ITEM_GUARD
};

