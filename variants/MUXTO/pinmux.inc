const uint16_t P400[] = {
PIN_PWM|CHANNEL_1|PWM_CHANNEL_A|GPT_ODD_CFG,
PIN_INTERRUPT|CHANNEL_0,
PIN_SDA|CHANNEL_1,
SCI_CHANNEL|PIN_CTS_RTS_SS|CHANNEL_0|SCI_EVEN_CFG,
SCI_CHANNEL|PIN_RX_MISO_SCL|CHANNEL_1|SCI_ODD_CFG,
PIN_MOSI|CHANNEL_0|LAST_ITEM_GUARD
};

const uint16_t P213[] = {
PIN_PWM|CHANNEL_0|PWM_CHANNEL_A|GPT_ODD_CFG,
PIN_INTERRUPT|CHANNEL_2,
SCI_CHANNEL|PIN_RX_MISO_SCL|CHANNEL_1|SCI_ODD_CFG|LAST_ITEM_GUARD
};

const uint16_t P212[] = {
PIN_PWM|CHANNEL_0|PWM_CHANNEL_B|GPT_ODD_CFG,
PIN_INTERRUPT|CHANNEL_3,
SCI_CHANNEL|PIN_TX_MOSI_SDA|CHANNEL_1|SCI_ODD_CFG|LAST_ITEM_GUARD
};

const uint16_t P408[] = {
PIN_PWM|CHANNEL_0|PWM_CHANNEL_A|GPT_ODD_CFG,
PIN_INTERRUPT|CHANNEL_1,
PIN_SDA|CHANNEL_0,
SCI_CHANNEL|PIN_RX_MISO_SCL|CHANNEL_0|SCI_EVEN_CFG,
SCI_CHANNEL|PIN_TX_MOSI_SDA|CHANNEL_1|SCI_ODD_CFG|LAST_ITEM_GUARD
};

const uint16_t P407[] = {
PIN_PWM|CHANNEL_0|PWM_CHANNEL_B|GPT_ODD_CFG,
PIN_INTERRUPT|CHANNEL_1,
PIN_SCL|CHANNEL_0,
SCI_CHANNEL|PIN_TX_MOSI_SDA|CHANNEL_0|SCI_EVEN_CFG,
SCI_CHANNEL|PIN_TX_MOSI_SDA|CHANNEL_9|SCI_ODD_CFG,
PIN_SCK|CHANNEL_1|LAST_ITEM_GUARD
};

const uint16_t P200[] = {
PIN_INTERRUPT|CHANNEL_0|LAST_ITEM_GUARD
};

const uint16_t P301[] = {
PIN_PWM|CHANNEL_2|PWM_CHANNEL_A|GPT_ODD_CFG,
PIN_INTERRUPT|CHANNEL_5,
PIN_SDA|CHANNEL_0,
SCI_CHANNEL|PIN_RX_MISO_SCL|CHANNEL_0|SCI_EVEN_CFG,
SCI_CHANNEL|PIN_CTS_RTS_SS|CHANNEL_9|SCI_ODD_CFG,
PIN_MOSI|CHANNEL_1|LAST_ITEM_GUARD
};

const uint16_t P110[] = {
PIN_PWM|CHANNEL_2|PWM_CHANNEL_B|GPT_ODD_CFG,
PIN_INTERRUPT|CHANNEL_2,
PIN_SDA|CHANNEL_1,
SCI_CHANNEL|PIN_TX_MOSI_SDA|CHANNEL_0|SCI_EVEN_CFG,
SCI_CHANNEL|PIN_RX_MISO_SCL|CHANNEL_9|SCI_ODD_CFG,
PIN_SCK|CHANNEL_0|LAST_ITEM_GUARD
};

const uint16_t P103[] = {
PIN_ANALOG|CHANNEL_19,
PIN_PWM|CHANNEL_6|PWM_CHANNEL_A|GPT_ODD_CFG,
PIN_SCK|CHANNEL_1|LAST_ITEM_GUARD
};

const uint16_t P102[] = {
PIN_ANALOG|CHANNEL_18,
PIN_PWM|CHANNEL_6|PWM_CHANNEL_B|GPT_ODD_CFG,
SCI_CHANNEL|PIN_CTS_RTS_SS|CHANNEL_9|SCI_ODD_CFG|LAST_ITEM_GUARD
};

const uint16_t P101[] = {
PIN_ANALOG|CHANNEL_17,
PIN_PWM|CHANNEL_5|PWM_CHANNEL_A|GPT_ODD_CFG,
PIN_INTERRUPT|CHANNEL_5,
SCI_CHANNEL|PIN_RX_MISO_SCL|CHANNEL_9|SCI_ODD_CFG|LAST_ITEM_GUARD
};

const uint16_t P100[] = {
PIN_ANALOG|CHANNEL_16,
PIN_PWM|CHANNEL_5|PWM_CHANNEL_B|GPT_ODD_CFG,
PIN_INTERRUPT|CHANNEL_4,
SCI_CHANNEL|PIN_TX_MOSI_SDA|CHANNEL_9|SCI_ODD_CFG|LAST_ITEM_GUARD
};

const uint16_t P500[] = {
PIN_ANALOG|CHANNEL_0,
PIN_PWM|CHANNEL_5|PWM_CHANNEL_A|GPT_ODD_CFG,
PIN_INTERRUPT|CHANNEL_3,
SCI_CHANNEL|PIN_RX_MISO_SCL|CHANNEL_0|SCI_EVEN_CFG|LAST_ITEM_GUARD
};

const uint16_t P501[] = {
PIN_ANALOG|CHANNEL_1,
PIN_PWM|CHANNEL_5|PWM_CHANNEL_B|GPT_ODD_CFG,
PIN_INTERRUPT|CHANNEL_2,
SCI_CHANNEL|PIN_TX_MOSI_SDA|CHANNEL_0|SCI_EVEN_CFG|LAST_ITEM_GUARD
};

const uint16_t P502[] = {
PIN_ANALOG|CHANNEL_2,
PIN_INTERRUPT|CHANNEL_1,
SCI_CHANNEL|PIN_CTS_RTS_SS|CHANNEL_0|SCI_EVEN_CFG|LAST_ITEM_GUARD
};

const uint16_t P013[] = {
PIN_ANALOG|CHANNEL_5,
PIN_PWM|CHANNEL_6|PWM_CHANNEL_B|GPT_ODD_CFG|LAST_ITEM_GUARD
};

const uint16_t P000[] = {
PIN_PWM|CHANNEL_4|PWM_CHANNEL_B|GPT_ODD_CFG,
PIN_INTERRUPT|CHANNEL_4,
PIN_SCL|CHANNEL_0,
SCI_CHANNEL|PIN_RX_MISO_SCL|CHANNEL_9|SCI_ODD_CFG,
PIN_MISO|CHANNEL_1|LAST_ITEM_GUARD
};

const uint16_t P109[] = {
PIN_PWM|CHANNEL_1|PWM_CHANNEL_B|GPT_ODD_CFG,
PIN_INTERRUPT|CHANNEL_3,
PIN_SCL|CHANNEL_1,
SCI_CHANNEL|PIN_SCK|CHANNEL_0|SCI_EVEN_CFG,
SCI_CHANNEL|PIN_TX_MOSI_SDA|CHANNEL_9|SCI_ODD_CFG,
PIN_MISO|CHANNEL_0|LAST_ITEM_GUARD
};

